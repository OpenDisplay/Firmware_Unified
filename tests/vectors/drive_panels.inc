/* GENERATED by tests/vectors/gen_drive_panels.py -- do not edit.
 * Source: Firmware_Unified v3/panel-data 07325ab, panels/generated/drive_presets.json.
 * Each packet is a BODY (instance byte first), as stored after the 4-byte
 * [number][id][len:2] header of the length-prefixed range. */
/* 0x0001 EP42_400x300: UC81xx mono, full only */
static const uint8_t fxp_ep42_400x300_0001_0[25] = { 0x00, 0x01, 0x01, 0x30, 0x75, 0x00, 0x00, 0x00, 0x01, 0x02, 0x03, 0x03, 0x0c, 0x02, 0x50, 0x17, 0x01, 0x02, 0x00, 0x01, 0x02, 0x07, 0xa5, 0x00, 0x00 };
static const uint8_t fxp_ep42_400x300_0001_1[81] = { 0x00, 0x00, 0x66, 0x75, 0x6c, 0x6c, 0x00, 0x00, 0x00, 0x00, 0x00, 0x00, 0x00,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 0x00, 0x00 };
static const uint8_t fxp_ep42_400x300_0001_2[328] = { 0x00, 0x01, 0x66, 0x61, 0x73, 0x74, 0x00, 0x00, 0x00, 0x00, 0x00, 0x00, 0x00,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 0x00, 0x00 };
static const uint8_t fxp_ep42_400x300_0001_3[543] = { 0x00, 0x02, 0x70, 0x61, 0x72, 0x74, 0x69, 0x61, 0x6c, 0x00, 0x00, 0x00, 0x00,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 0x00, 0x00 };
static const uint8_t fxp_ep42_400x300_0001_4[90] = { 0x00, 0x00, 0x24, 0x43, 0x00, 0x20, 0x01, 0x00, 0x00, 0x01, 0x00, 0x00, 0x00,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 0x00, 0x00 };
static const fx_panel_pkt_t fxp_ep42_400x300_0001[] = {
    { 0xB1, fxp_ep42_400x300_0001_0, 25 },
    { 0xAE, fxp_ep42_400x300_0001_1, 81 },
    { 0xAE, fxp_ep42_400x300_0001_2, 328 },
    { 0xAE, fxp_ep42_400x300_0001_3, 543 },
    { 0xAF, fxp_ep42_400x300_0001_4, 90 },
};
/* 0x0002 EP42B_400x300: SSD16xx mono, full + fast + partial */
static const uint8_t fxp_ep42b_400x300_0002_0[28] = { 0x00, 0x01, 0x00, 0x30, 0x75, 0x00, 0x00, 0x00, 0x01, 0x02, 0x03, 0x03, 0x0f, 0x02, 0x3f, 0x22, 0x02, 0x22, 0x83, 0x01, 0x20, 0x00, 0x01, 0x02, 0x10, 0x03, 0x00, 0x00 };
static const uint8_t fxp_ep42b_400x300_0002_1[116] = { 0x00, 0x00, 0x66, 0x75, 0x6c, 0x6c, 0x00, 0x00, 0x00, 0x00, 0x00, 0x00, 0x00,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 0x00, 0x00 };
static const uint8_t fxp_ep42b_400x300_0002_2[126] = { 0x00, 0x01, 0x66, 0x61, 0x73, 0x74, 0x00, 0x00, 0x00, 0x00, 0x00, 0x00, 0x00,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 0x00, 0x00 };
static const uint8_t fxp_ep42b_400x300_0002_3[202] = { 0x00, 0x02, 0x70, 0x61, 0x72, 0x74, 0x69, 0x61, 0x6c, 0x00, 0x00, 0x00, 0x00,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 0x00, 0x00 };
static const fx_panel_pkt_t fxp_ep42b_400x300_0002[] = {
    { 0xB1, fxp_ep42b_400x300_0002_0, 28 },
    { 0xAE, fxp_ep42b_400x300_0002_1, 116 },
    { 0xAE, fxp_ep42b_400x300_0002_2, 126 },
    { 0xAE, fxp_ep42b_400x300_0002_3, 202 },
};
/* 0x0014 EP75_800x480: UC81xx 7.5in mono, large frame */
static const uint8_t fxp_ep75_800x480_0014_0[25] = { 0x00, 0x01, 0x01, 0x30, 0x75, 0x00, 0x00, 0x00, 0x01, 0x02, 0x03, 0x03, 0x0c, 0x02, 0x50, 0x17, 0x01, 0x02, 0x00, 0x01, 0x02, 0x07, 0xa5, 0x00, 0x00 };
static const uint8_t fxp_ep75_800x480_0014_1[105] = { 0x00, 0x00, 0x66, 0x75, 0x6c, 0x6c, 0x00, 0x00, 0x00, 0x00, 0x00, 0x00, 0x00,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 0x00, 0x00 };
static const uint8_t fxp_ep75_800x480_0014_2[371] = { 0x00, 0x01, 0x66, 0x61, 0x73, 0x74, 0x00, 0x00, 0x00, 0x00, 0x00, 0x00, 0x00,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 0x00, 0x00 };
static const uint8_t fxp_ep75_800x480_0014_3[529] = { 0x00, 0x02, 0x70, 0x61, 0x72, 0x74, 0x69, 0x61, 0x6c, 0x00, 0x00, 0x00, 0x00,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 0x00, 0x00 };
static const uint8_t fxp_ep75_800x480_0014_4[130] = { 0x00, 0x00, 0xb0, 0xb1, 0x00, 0x1e, 0x01, 0x1e, 0x01, 0x01, 0x00, 0x00, 0x00,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 0x00, 0x00 };
static const fx_panel_pkt_t fxp_ep75_800x480_0014[] = {
    { 0xB1, fxp_ep75_800x480_0014_0, 25 },
    { 0xAE, fxp_ep75_800x480_0014_1, 105 },
    { 0xAE, fxp_ep75_800x480_0014_2, 371 },
    { 0xAE, fxp_ep75_800x480_0014_3, 529 },
    { 0xAF, fxp_ep75_800x480_0014_4, 130 },
};
/* 0x001E EP29YR_168x384: UC81xx BWRY 2.9in, colour16 3-pass with LUT slots (ODBEEBA6 glass) */
static const uint8_t fxp_ep29yr_168x384_001e_0[21] = { 0x00, 0x03, 0x01, 0x30, 0x75, 0x00, 0x00, 0x00, 0x01, 0x03, 0x02, 0x02, 0x08, 0x02, 0x02, 0x00, 0x02, 0x07, 0xa5, 0x00, 0x00 };
static const uint8_t fxp_ep29yr_168x384_001e_1[108] = { 0x00, 0x00, 0x66, 0x75, 0x6c, 0x6c, 0x00, 0x00, 0x00, 0x00, 0x00, 0x00, 0x00,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 0x00, 0x00 };
static const uint8_t fxp_ep29yr_168x384_001e_2[136] = { 0x00, 0x01, 0x63, 0x6f, 0x6c, 0x6f, 0x75, 0x72, 0x31, 0x36, 0x00, 0x00, 0x00,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 0x00, 0x00 };
static const uint8_t fxp_ep29yr_168x384_001e_3[539] = { 0x00, 0x00, 0xaf, 0x77, 0x00, 0x22, 0x78, 0x2d, 0x22, 0x20, 0x08, 0xef, 0x7f,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 0xff, 0xff };
static const uint8_t fxp_ep29yr_168x384_001e_4[539] = { 0x00, 0x01, 0x24, 0xd0, 0x00, 0x14, 0x78, 0x14, 0x14, 0x24, 0x08, 0xef, 0x7f,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 0xff, 0xff };
static const uint8_t fxp_ep29yr_168x384_001e_5[132] = { 0x00, 0x01, 0x00, 0x10, 0x02, 0x00, 0xe7, 0x0b, 0x66, 0x03, 0xca, 0x01, 0x15,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 0x06, 0x03 };
static const fx_panel_pkt_t fxp_ep29yr_168x384_001e[] = {
    { 0xB1, fxp_ep29yr_168x384_001e_0, 21 },
    { 0xAE, fxp_ep29yr_168x384_001e_1, 108 },
    { 0xAE, fxp_ep29yr_168x384_001e_2, 136 },
    { 0xAF, fxp_ep29yr_168x384_001e_3, 539 },
    { 0xAF, fxp_ep29yr_168x384_001e_4, 539 },
    { 0xB0, fxp_ep29yr_168x384_001e_5, 132 },
};
/* 0x0024 EP74R_640x384: UC81xx BWR two controller planes */
static const uint8_t fxp_ep74r_640x384_0024_0[25] = { 0x00, 0x01, 0x01, 0x40, 0x9c, 0x00, 0x00, 0x00, 0x01, 0x02, 0x03, 0x01, 0x0c, 0x02, 0x50, 0x17, 0x01, 0x02, 0x00, 0x01, 0x02, 0x07, 0xa5, 0x00, 0x00 };
static const uint8_t fxp_ep74r_640x384_0024_1[159] = { 0x00, 0x00, 0x66, 0x75, 0x6c, 0x6c, 0x00, 0x00, 0x00, 0x00, 0x00, 0x00, 0x00,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 0x00, 0x00 };
static const fx_panel_pkt_t fxp_ep74r_640x384_0024[] = {
    { 0xB1, fxp_ep74r_640x384_0024_0, 25 },
    { 0xAE, fxp_ep74r_640x384_0024_1, 159 },
};
/* 0x0028 EP426_800x480_4GRAY: SSD16xx 4-grey */
static const uint8_t fxp_ep426_800x480_4gray_0028_0[18] = { 0x00, 0x01, 0x00, 0x30, 0x75, 0x00, 0x00, 0x00, 0x01, 0x02, 0x03, 0x02, 0x05, 0x02, 0x10, 0x03, 0x00, 0x00 };
static const uint8_t fxp_ep426_800x480_4gray_0028_1[244] = { 0x00, 0x00, 0x66, 0x75, 0x6c, 0x6c, 0x00, 0x00, 0x00, 0x00, 0x00, 0x00, 0x00,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 0x00, 0x00 };
static const uint8_t fxp_ep426_800x480_4gray_0028_2[409] = { 0x00, 0x01, 0x66, 0x61, 0x73, 0x74, 0x00, 0x00, 0x00, 0x00, 0x00, 0x00, 0x00,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 0x00, 0x00 };
static const fx_panel_pkt_t fxp_ep426_800x480_4gray_0028[] = {
    { 0xB1, fxp_ep426_800x480_4gray_0028_0, 18 },
    { 0xAE, fxp_ep426_800x480_4gray_0028_1, 244 },
    { 0xAE, fxp_ep426_800x480_4gray_0028_2, 409 },
};
/* 0x0033 EP579_792x272: SSD16xx 7.9in, SET_PIN */
static const uint8_t fxp_ep579_792x272_0033_0[28] = { 0x00, 0x01, 0x00, 0x30, 0x75, 0x00, 0x00, 0x00, 0x01, 0x02, 0x03, 0x02, 0x0f, 0x02, 0x3f, 0x22, 0x02, 0x22, 0x83, 0x01, 0x20, 0x00, 0x01, 0x02, 0x10, 0x03, 0x00, 0x00 };
static const uint8_t fxp_ep579_792x272_0033_1[90] = { 0x00, 0x00, 0x66, 0x75, 0x6c, 0x6c, 0x00, 0x00, 0x00, 0x00, 0x00, 0x00, 0x00,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 0x00, 0x00 };
static const uint8_t fxp_ep579_792x272_0033_2[104] = { 0x00, 0x01, 0x66, 0x61, 0x73, 0x74, 0x00, 0x00, 0x00, 0x00, 0x00, 0x00, 0x00,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 0x00, 0x00 };
static const fx_panel_pkt_t fxp_ep579_792x272_0033[] = {
    { 0xB1, fxp_ep579_792x272_0033_0, 28 },
    { 0xAE, fxp_ep579_792x272_0033_1, 90 },
    { 0xAE, fxp_ep579_792x272_0033_2, 104 },
};
/* 0x0023 EP73_SPECTRA_800x480: UC81xx Spectra 6 */
static const uint8_t fxp_ep73_spectra_800x480_0023_0[18] = { 0x00, 0x01, 0x01, 0x60, 0xea, 0x00, 0x00, 0x00, 0x01, 0x02, 0x03, 0x02, 0x05, 0x02, 0x02, 0x00, 0x00, 0x00 };
static const uint8_t fxp_ep73_spectra_800x480_0023_1[137] = { 0x00, 0x00, 0x66, 0x75, 0x6c, 0x6c, 0x00, 0x00, 0x00, 0x00, 0x00, 0x00, 0x00,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 0x00, 0x00 };
static const uint8_t fxp_ep73_spectra_800x480_0023_2[226] = { 0x00, 0x01, 0x66, 0x61, 0x73, 0x74, 0x00, 0x00, 0x00, 0x00, 0x00, 0x00, 0x00,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 0x00, 0x00 };
static const fx_panel_pkt_t fxp_ep73_spectra_800x480_0023[] = {
    { 0xB1, fxp_ep73_spectra_800x480_0023_0, 18 },
    { 0xAE, fxp_ep73_spectra_800x480_0023_1, 137 },
    { 0xAE, fxp_ep73_spectra_800x480_0023_2, 226 },
};
/* 0x0034 EP213YR_122x250: UC81xx BWRY 2.13in, full + fast */
static const uint8_t fxp_ep213yr_122x250_0034_0[23] = { 0x00, 0x01, 0x01, 0x40, 0x9c, 0x00, 0x00, 0x00, 0x01, 0x02, 0x03, 0x02, 0x0a, 0x02, 0x02, 0x00, 0x00, 0x01, 0x02, 0x07, 0xa5, 0x00, 0x00 };
static const uint8_t fxp_ep213yr_122x250_0034_1[62] = { 0x00, 0x00, 0x66, 0x75, 0x6c, 0x6c, 0x00, 0x00, 0x00, 0x00, 0x00, 0x00, 0x00,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 0x00, 0x00 };
static const uint8_t fxp_ep213yr_122x250_0034_2[74] = { 0x00, 0x01, 0x66, 0x61, 0x73, 0x74, 0x00, 0x00, 0x00, 0x00, 0x00, 0x00, 0x00,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 0x00, 0x00 };
static const fx_panel_pkt_t fxp_ep213yr_122x250_0034[] = {
    { 0xB1, fxp_ep213yr_122x250_0034_0, 23 },
    { 0xAE, fxp_ep213yr_122x250_0034_1, 62 },
    { 0xAE, fxp_ep213yr_122x250_0034_2, 74 },
};
/* 0x0040 EP75YR_800x480: UC81xx BWRY 7.5in, colour16 (LUT after full init) */
static const uint8_t fxp_ep75yr_800x480_0040_0[21] = { 0x00, 0x03, 0x01, 0x40, 0x9c, 0x00, 0x00, 0x00, 0x01, 0x03, 0x02, 0x02, 0x08, 0x02, 0x02, 0x00, 0x02, 0x07, 0xa5, 0x00, 0x00 };
static const uint8_t fxp_ep75yr_800x480_0040_1[117] = { 0x00, 0x00, 0x66, 0x75, 0x6c, 0x6c, 0x00, 0x00, 0x00, 0x00, 0x00, 0x00, 0x00,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 0x00, 0x00 };
static const uint8_t fxp_ep75yr_800x480_0040_2[121] = { 0x00, 0x01, 0x63, 0x6f, 0x6c, 0x6f, 0x75, 0x72, 0x31, 0x36, 0x00, 0x00, 0x00,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 0x00, 0x00 };
static const uint8_t fxp_ep75yr_800x480_0040_3[539] = { 0x00, 0x00, 0xaf, 0x77, 0x00, 0x22, 0x78, 0x2d, 0x22, 0x20, 0x08, 0xef, 0x7f,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 0xff, 0xff };
static const uint8_t fxp_ep75yr_800x480_0040_4[539] = { 0x00, 0x01, 0x24, 0xd0, 0x00, 0x14, 0x78, 0x14, 0x14, 0x24, 0x08, 0xef, 0x7f,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 0xff, 0xff };
static const uint8_t fxp_ep75yr_800x480_0040_5[132] = { 0x00, 0x01, 0x00, 0x10, 0x03, 0x00, 0xe7, 0x0b, 0x66, 0x03, 0xca, 0x01, 0x15,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 0x06, 0x03 };
static const fx_panel_pkt_t fxp_ep75yr_800x480_0040[] = {
    { 0xB1, fxp_ep75yr_800x480_0040_0, 21 },
    { 0xAE, fxp_ep75yr_800x480_0040_1, 117 },
    { 0xAE, fxp_ep75yr_800x480_0040_2, 121 },
    { 0xAF, fxp_ep75yr_800x480_0040_3, 539 },
    { 0xAF, fxp_ep75yr_800x480_0040_4, 539 },
    { 0xB0, fxp_ep75yr_800x480_0040_5, 132 },
};
static const fx_panel_t FX_PANELS[] = {
    { "EP42_400x300_0x0001", 400, 300, 0, fxp_ep42_400x300_0001, 5 },
    { "EP42B_400x300_0x0002", 400, 300, 0, fxp_ep42b_400x300_0002, 4 },
    { "EP75_800x480_0x0014", 800, 480, 0, fxp_ep75_800x480_0014, 5 },
    { "EP29YR_168x384_0x001E", 168, 384, 3, fxp_ep29yr_168x384_001e, 6 },
    { "EP74R_640x384_0x0024", 640, 384, 1, fxp_ep74r_640x384_0024, 2 },
    { "EP426_800x480_4GRAY_0x0028", 800, 480, 5, fxp_ep426_800x480_4gray_0028, 3 },
    { "EP579_792x272_0x0033", 792, 272, 0, fxp_ep579_792x272_0033, 3 },
    { "EP73_SPECTRA_800x480_0x0023", 800, 480, 4, fxp_ep73_spectra_800x480_0023, 3 },
    { "EP213YR_122x250_0x0034", 122, 250, 3, fxp_ep213yr_122x250_0034, 3 },
    { "EP75YR_800x480_0x0040", 800, 480, 3, fxp_ep75yr_800x480_0040, 6 },
};
#define FX_PANEL_COUNT 10
